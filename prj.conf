## CMakeLists.txt
```
# Oldest CMake version this file is written for
cmake_minimum_required(VERSION 3.20.0)
#find the bindings
list(APPEND DTS_ROOT ${CMAKE_CURRENT_SOURCE_DIR}/../..)

# Pull in Zephyr's build system (kernel, drivers, devicetree, Kconfig).
# HINTS uses ZEPHYR_BASE if it's set; otherwise CMake finds Zephyr
# through the registration from "west zephyr-export".
find_package(Zephyr REQUIRED HINTS $ENV{ZEPHYR_BASE})

# Name of your project
project(light_hub)

# Add your source files to "app", the target Zephyr creates for your code
target_sources(app PRIVATE
    src/main.c
    src/bulb_mgr.c
    src/packet.c
    src/uart_link.c
    src/protocol.c
)
```

## west.yml
```
manifest:
  self:
    path: light-hub

  remotes:
    - name: zephyrproject-rtos
      url-base: https://github.com/zephyrproject-rtos

  projects:
    - name: zephyr
      remote: zephyrproject-rtos
      revision: v4.4.0
      import:
        name-allowlist:
          - picolibc
```

## prj.conf
```kconfig
CONFIG_QEMU_ICOUNT=n
CONFIG_SERIAL=y
CONFIG_UART_INTERRUPT_DRIVEN=y
# Logging (LOG_ERR/WRN/INF/DBG). Default level is INF, so LOG_DBG is hidden.
CONFIG_LOG=y
# Print logs right away in the caller's thread, so log lines and the
# typed-character echo come out in the right order with no delay.
CONFIG_LOG_MODE_IMMEDIATE=y
CONFIG_CRC=y
```

## dts/bindings/lighthub,pca9685-led.yaml
```yaml
description: PCA9685 16-channel PWM chip driving RGB bulbs

compatible: "lighthub,pca9685-led"

include: i2c-device.yaml
```

## src/main.c
```c
#include <stdio.h>
#include <zephyr/kernel.h>

struct bulb_cmd{
    uint8_t bulb_id;
    uint8_t r;
    uint8_t g;
    uint8_t b;
};

/*Queue holding up to 8 bulb_cmd structs, buffer alighned to 4 bytes*/
K_MSGQ_DEFINE(cmd_q, sizeof(struct bulb_cmd), 8, 4);

//Producer makes fake command every sec and queues it
void producer(void *p1, void *p2, void *p3){
    /* A few colors to cycle through: red, green, blue, white */
    const uint8_t colors[4][3] = {
        {255, 0, 0}, {0, 255, 0}, {0, 0, 255}, {255, 255, 255}
    };
    uint8_t i = 0;

    while (1){
        struct bulb_cmd cmd = {
            .bulb_id = i % 3,          /* bulbs 0, 1, 2 */
            .r = colors[i % 4][0],
            .g = colors[i % 4][1],
            .b = colors[i % 4][2],
        };
        //copy cmd into queue; wait forever if full
        int ret = k_msgq_put(&cmd_q, &cmd, K_FOREVER);
        if(ret!=0){
            printk("put failed:%d\n", ret);
        }
        printk("queue used: %u\n", k_msgq_num_used_get(&cmd_q));
        i++;
        k_msleep(1000);
    }
}

void consumer(void *p1, void *p2, void *p3){
    struct bulb_cmd cmd;
    while(1){
        //sleep until message arrive then copy into cmd
        k_msgq_get(&cmd_q,&cmd, K_FOREVER);

        printk("Bulb %u -> R=%u G=%u B=%u\n",
               cmd.bulb_id, cmd.r, cmd.g, cmd.b);
               
    }
    
}

/*create both threads at compile time, 1KB stack each
 producer priority 5, consumer 7 (lower no = higher priority)*/
K_THREAD_DEFINE(prod_id, 1024, producer, NULL, NULL, NULL, 5,0,0);
K_THREAD_DEFINE(cons_id, 1024, consumer, NULL, NULL, NULL, 7, 0, 0);


int main(void)
{
    printk("Light hub starting\n");
    return 0;  /* main ends, but the two threads keep running */
}
```

## src/bulb_cmd.h
```c
#pragma once

#include <stdint.h>

/* One "set this bulb to this colour" request */
struct bulb_cmd {
    uint8_t bulb_id;
    uint8_t r;
    uint8_t g;
    uint8_t b;
};
```

## src/bulb_mgr.c
```c
#include <zephyr/kernel.h>
#include <zephyr/logging/log.h>

#include "bulb_cmd.h"
#include "bulb_mgr.h"

static struct bulb_cmd bulbs[8];

LOG_MODULE_REGISTER(bulb_mgr, LOG_LEVEL_INF);

/* Queue holding up to 8 bulb_cmd structs, buffer aligned to 4 bytes */
K_MSGQ_DEFINE(cmd_q, sizeof(struct bulb_cmd), 8, 4);
/*define mutex*/
K_MUTEX_DEFINE(bulbs_lock);

/* Consumer: applies bulb commands (for now, just prints them) */
static void bulb_mgr_thread(void *p1, void *p2, void *p3)
{
    ARG_UNUSED(p1);
    ARG_UNUSED(p2);
    ARG_UNUSED(p3);

    struct bulb_cmd cmd;

    while (1) {
        /* Sleep until a message arrives, then copy it into cmd */  
        k_msgq_get(&cmd_q, &cmd, K_FOREVER);
        k_mutex_lock(&bulbs_lock, K_FOREVER);
        bulbs[cmd.bulb_id]= cmd;   
        k_mutex_unlock(&bulbs_lock);    
        LOG_INF("Bulb %u -> R=%u G=%u B=%u", cmd.bulb_id, cmd.r, cmd.g, cmd.b); 
    }
}
/* Copy bulb id's current state into *out. Returns 0, or -EINVAL if id > 7. */
int bulb_mgr_get_state(uint8_t id, struct bulb_cmd *out){
    if(id >= BULB_COUNT) return -EINVAL;
    k_mutex_lock(&bulbs_lock, K_FOREVER);
    *out = bulbs[id];
    k_mutex_unlock(&bulbs_lock);
    return 0;
}

/* 1KB stack, priority 7 (lower number = higher priority) */
K_THREAD_DEFINE(bulb_mgr_id, 1024, bulb_mgr_thread, NULL, NULL, NULL, 7, 0, 0);
```

## src/bulb_mgr.h
```c
#pragma once

#include <zephyr/kernel.h>

/* Queue of struct bulb_cmd. Producers put commands here, bulb_mgr_thread consumes them. */
extern struct k_msgq cmd_q;
```

## src/packet.c
```c
#include <zephyr/sys/crc.h>
#include <zephyr/sys/byteorder.h>
#include <packet.h> 


void pkt_rx_reset(struct pkt_rx *rx){
    rx->state = PKT_WAIT_MAGIC;
    rx->idx = 0;
    rx->payload_len = 0;
}

enum pkt_rx_result pkt_rx_feed(struct pkt_rx *rx, uint8_t byte)
{
    switch (rx->state) {
    case PKT_WAIT_MAGIC:
        /* ignore until 0xAA; store it, move to HEADER */
        while(byte != 0xAA){
        }
        rx->buf[0] = 0xAA;
        rx->idx = 1;
        rx->state = PKT_HEADER;
        break;

    case PKT_HEADER:
        /* store byte; once idx == PKT_HEADER_LEN, read length,
           check it, then go to PAYLOAD or CRC */
        
        break;

    case PKT_PAYLOAD:
        /* store byte; once all payload bytes are in, go to CRC */
        break;

    case PKT_CRC:
        /* store byte; once both CRC bytes are in, compute and compare,
           reset, and return DONE or BAD_CRC */
        break;
    }

    return PKT_RX_INCOMPLETE;
}
```

## src/packet.h
```c
#include <stdint.h>
#include <stddef.h>
#pragma once
#define PKT_MAGIC        0xAA
#define PKT_VERSION      0x01
#define PKT_HEADER_LEN   6
#define PKT_MAX_PAYLOAD  32
#define PKT_CRC_LEN      2
#define PKT_MAX_LEN      (PKT_HEADER_LEN + PKT_MAX_PAYLOAD + PKT_CRC_LEN)

enum pkt_rx_state {
    PKT_WAIT_MAGIC,
    PKT_HEADER,
    PKT_PAYLOAD,
    PKT_CRC,
};

/* Receiver state: everything it must remember between bytes */
struct pkt_rx {
    enum pkt_rx_state state;
    uint8_t buf[PKT_MAX_LEN];   /* the raw packet as it arrives */
    size_t idx;                 /* how many bytes are in buf so far */
    uint16_t payload_len;       /* read from the header */
};

/* Results of feeding one byte */
enum pkt_rx_result {
    PKT_RX_INCOMPLETE,   /* need more bytes */
    PKT_RX_DONE,         /* a full packet with valid CRC is in buf */
    PKT_RX_BAD_CRC,      /* full packet arrived, CRC mismatch */
    PKT_RX_BAD_LENGTH,   /* header claimed length > 32 */
};

enum pkt_type {
    PKT_TYPE_SET_COLOR = 0x01,
    PKT_TYPE_GET_STATE = 0x02,
    PKT_TYPE_RESPONSE  = 0x80,
    PKT_TYPE_STATE     = 0x81,
};

enum pkt_status {
    PKT_STATUS_OK           = 0x00,
    PKT_STATUS_BAD_VERSION  = 0x01,
    PKT_STATUS_UNKNOWN_TYPE = 0x02,
    PKT_STATUS_BAD_LENGTH   = 0x03,
    PKT_STATUS_INVALID_BULB = 0x04,
    PKT_STATUS_BUSY = 0x05,   
};

void pkt_rx_reset(struct pkt_rx *rx);
enum pkt_rx_result pkt_rx_feed(struct pkt_rx *rx, uint8_t byte);
size_t pkt_build(uint8_t *out, uint8_t type, uint8_t seq,
                 const uint8_t *payload, uint16_t len);
```

## src/parser.c
```c
#include <errno.h>
#include <stdlib.h>

#include "parser.h"

int parse_bulb_cmd(const char *line, struct bulb_cmd *out)
{
    unsigned long vals[4];
    const char *p = line;
    char *end;

    for (int i = 0; i < 4; i++) {
        vals[i] = strtoul(p, &end, 10);
        if (end == p) {
            return -EINVAL; /* no number found */
        }
        if (vals[i] > 255) {
            return -EINVAL; /* won't fit in uint8_t */
        }
        p = end; /* continue after this number */
    }

    /* Only allow trailing spaces */
    while (*p == ' ') {
        p++;
    }
    if (*p != '\0') {
        return -EINVAL;
    }

    out->bulb_id = (uint8_t)vals[0];
    out->r = (uint8_t)vals[1];
    out->g = (uint8_t)vals[2];
    out->b = (uint8_t)vals[3];
    return 0;
}
```

## src/parser.h
```c
#pragma once

#include "bulb_cmd.h"

/*
 * Parse "<bulb> <r> <g> <b>" (each 0-255) into *out.
 * Returns 0 on success, -EINVAL otherwise. *out is only written on success.
 */
int parse_bulb_cmd(const char *line, struct bulb_cmd *out);
```

## src/protocol.c
```c
#include <zephyr/kernel.h>
#include <zephyr/logging/log.h>
#include "protocol.h"
#include "packet.h"
#include "bulb_cmd.h"
#include "bulb_mgr.h"

LOG_MODULE_REGISTER(protocol, LOG_LEVEL_INF);

/* Expected payload sizes per message type */
#define SET_COLOR_LEN 4
#define GET_STATE_LEN 1

/* Build a RESPONSE packet carrying one status byte */
static size_t respond_status(uint8_t *resp, uint8_t seq, uint8_t status)
{
    return pkt_build(resp, PKT_TYPE_RESPONSE, seq, &status, 1);
}

size_t proto_handle(const struct pkt_rx *rx, uint8_t *resp)
{
    /* Header fields, at the offsets from PROTOCOL.md */
    uint8_t version = rx->buf[1];
    uint8_t type    = rx->buf[2];
    uint8_t seq     = rx->buf[3];
    uint16_t len    = rx->payload_len;
    const uint8_t *payload = &rx->buf[PKT_HEADER_LEN];

    /* Rule 5: version */
    if (version != PKT_VERSION) {
        LOG_WRN("Bad version %u (seq %u)", version, seq);
        return respond_status(resp, seq, PKT_STATUS_BAD_VERSION);
    }

    switch (type) {

    case PKT_TYPE_SET_COLOR: {
        /* Rule 7: length for this type */
        if (len != SET_COLOR_LEN) {
            return respond_status(resp, seq, PKT_STATUS_BAD_LENGTH);
        }
        /* Rule 8: bulb ID */
        if (payload[0] >= BULB_COUNT) {
            return respond_status(resp, seq, PKT_STATUS_INVALID_BULB);
        }

        struct bulb_cmd cmd = {
            .bulb_id = payload[0],
            .r = payload[1],
            .g = payload[2],
            .b = payload[3],
        };

        /* Never block the receive path: if bulb_mgr is behind, say so */
        if (k_msgq_put(&cmd_q, &cmd, K_NO_WAIT) != 0) {
            LOG_WRN("Command queue full (seq %u)", seq);
            return respond_status(resp, seq, PKT_STATUS_BUSY);
        }
        return respond_status(resp, seq, PKT_STATUS_OK);
    }

    case PKT_TYPE_GET_STATE: {
        struct bulb_cmd state;

        if (len != GET_STATE_LEN) {
            return respond_status(resp, seq, PKT_STATUS_BAD_LENGTH);
        }
        if (bulb_mgr_get_state(payload[0], &state) != 0) {
            return respond_status(resp, seq, PKT_STATUS_INVALID_BULB);
        }

        uint8_t out[4] = { state.bulb_id, state.r, state.g, state.b };
        return pkt_build(resp, PKT_TYPE_STATE, seq, out, sizeof(out));
    }

    default:
        /* Rule 6: unknown type. This also covers hub-to-host types
         * like RESPONSE being sent *to* the hub, which makes no sense. */
        LOG_WRN("Unknown type 0x%02x (seq %u)", type, seq);
        return respond_status(resp, seq, PKT_STATUS_UNKNOWN_TYPE);
    }
}
```

## src/protocol.h
```c
#pragma once

#include <stddef.h>
#include <stdint.h>
#include "packet.h"

/* Handle a complete, CRC-valid packet.
 * Writes a response packet into resp (PKT_MAX_LEN bytes).
 * Returns the response length, or 0 for no response. */
size_t proto_handle(const struct pkt_rx *rx, uint8_t *resp);
```

## src/uart_link.c
```c
#include <errno.h>
#include <stdbool.h>
#include <zephyr/kernel.h>
#include <zephyr/drivers/uart.h>
#include <zephyr/logging/log.h>
#include "packet.h"
#include "protocol.h"

#include "bulb_cmd.h"
#include "bulb_mgr.h"

#include "uart_link.h"

#define PKT_RX_TIMEOUT_MS 100

LOG_MODULE_REGISTER(uart_rx, LOG_LEVEL_INF);


/* DEVICE_DT_GET(node_id): pointer to a device's driver instance from its devicetree node.
 * DT_CHOSEN(zephyr_console) means "the node devicetree has chosen as the console". */
static const struct device *const uart = DEVICE_DT_GET(DT_CHOSEN(zephyr_console));

/* Byte queue: 1-byte messages, 32 slots, alignment 1 */
K_MSGQ_DEFINE(rx_q, 1, 32, 1);

/* Bytes dropped because rx_q was full. Written in the ISR, read by threads. */
static volatile uint32_t rx_dropped;

/* ISR callback: move every received byte into rx_q */
static void uart_receive(const struct device *dev, void *user_data)
{
    ARG_UNUSED(user_data);

    uint8_t byte;

    /* Call first to refresh the interrupt status */
    if (!uart_irq_update(dev)) {
        return;
    }

    if (uart_irq_rx_ready(dev)) {
        while (uart_fifo_read(dev, &byte, 1)) {
            if (k_msgq_put(&rx_q, &byte, K_NO_WAIT) != 0) {
                rx_dropped++; /* queue full: count it, don't print in the ISR */
            }
        }
    }
}

/* RX thread: turns the byte stream from the ISR into packets,
 * hands complete packets to the protocol handler, sends responses */
static void rx_thread(void *p1, void *p2, void *p3)
{
    struct pkt_rx rx;
    uint8_t resp[PKT_MAX_LEN];//response packet
    uint8_t byte;

    ARG_UNUSED(p1);
    ARG_UNUSED(p2);
    ARG_UNUSED(p3);

    pkt_rx_reset(&rx);

    while (1) {
        /* Idle: wait forever. Mid-packet: give up after 100 ms */
        k_timeout_t timeout = (rx.state == PKT_WAIT_MAGIC)
                              ? K_FOREVER
                              : K_MSEC(PKT_RX_TIMEOUT_MS);

        if (k_msgq_get(&rx_q, &byte, timeout) != 0) {
            LOG_WRN("Packet timed out, resyncing");
            pkt_rx_reset(&rx);
            continue;
        }

        switch (pkt_rx_feed(&rx, byte)) { //byte gotten from rx_q, which is then fed to rx
        case PKT_RX_DONE: {
            size_t n = proto_handle(&rx, resp);//response packet got build
            if (n > 0) {
                uart_send(resp, n);
            }
            break;
        }
        case PKT_RX_BAD_CRC:
            LOG_WRN("Bad CRC, packet dropped");
            break;
        case PKT_RX_BAD_LENGTH:
            LOG_WRN("Length over %d, packet dropped", PKT_MAX_PAYLOAD);
            break;
        case PKT_RX_INCOMPLETE:
        default:
            break;
        }
    }
}


/* 1KB stack, priority 5: runs ahead of bulb_mgr_thread (priority 7) */
K_THREAD_DEFINE(rx_id, 1024, rx_thread, NULL, NULL, NULL, 5, 0, 0);

int uart_rx_init(void)
{
    int err;

    if (!device_is_ready(uart)) {
        return -ENODEV;
    }

    err = uart_irq_callback_user_data_set(uart, uart_receive, NULL);
    if (err) {
        return err;
    }

    uart_irq_rx_enable(uart);
    return 0;
}

void uart_send(const uint8_t *data, size_t len){
    for(size_t i=0; i<len; i++){
        uart_poll_out(uart, data[i]);
    }

}
```

## src/uart_link.h
```c
#pragma once

/*
 * Set up interrupt-driven UART RX on the console UART.
 * Returns 0 on success, -ENODEV if the UART isn't ready,
 * or the error from uart_irq_callback_user_data_set().
 */
int uart_rx_init(void);
void uart_send(const uint8_t *data, size_t len);
```

## src/uart_rx.c
```c
#include <errno.h>
#include <stdbool.h>
#include <zephyr/kernel.h>
#include <zephyr/drivers/uart.h>
#include <zephyr/logging/log.h>

#include "bulb_cmd.h"
#include "bulb_mgr.h"
#include "parser.h"
#include "uart_rx.h"

LOG_MODULE_REGISTER(uart_rx, LOG_LEVEL_INF);

#define LINE_MAX 64

/* DEVICE_DT_GET(node_id): pointer to a device's driver instance from its devicetree node.
 * DT_CHOSEN(zephyr_console) means "the node devicetree has chosen as the console". */
static const struct device *const uart = DEVICE_DT_GET(DT_CHOSEN(zephyr_console));

/* Byte queue: 1-byte messages, 32 slots, alignment 1 */
K_MSGQ_DEFINE(rx_q, 1, 32, 1);

/* Bytes dropped because rx_q was full. Written in the ISR, read by threads. */
static volatile uint32_t rx_dropped;

/* ISR callback: move every received byte into rx_q */
static void uart_receive(const struct device *dev, void *user_data)
{
    ARG_UNUSED(user_data);

    uint8_t byte;

    /* Call first to refresh the interrupt status */
    if (!uart_irq_update(dev)) {
        return;
    }

    if (uart_irq_rx_ready(dev)) {
        while (uart_fifo_read(dev, &byte, 1)) {
            if (k_msgq_put(&rx_q, &byte, K_NO_WAIT) != 0) {
                rx_dropped++; /* queue full: count it, don't print in the ISR */
            }
        }
    }
}

/* RX thread: turns the byte stream from the ISR into complete lines */
static void rx_thread(void *p1, void *p2, void *p3)
{
    ARG_UNUSED(p1);
    ARG_UNUSED(p2);
    ARG_UNUSED(p3);

    char line[LINE_MAX];
    size_t len = 0;
    bool overflow = false;
    uint8_t byte;

    while (1) {
        /* Sleep until the ISR queues a byte */
        k_msgq_get(&rx_q, &byte, K_FOREVER);

        /* Enter key: end of line */
        if (byte == '\r' || byte == '\n') {
            printk("\n");

            if (overflow) {
                LOG_WRN("Line too long, discarded");
            } else if (len > 0) {
                line[len] = '\0'; /* terminate the C string */
                LOG_DBG("Got line: %s", line);

                struct bulb_cmd cmd;

                if (parse_bulb_cmd(line, &cmd) == 0) {
                    k_msgq_put(&cmd_q, &cmd, K_FOREVER);
                } else {
                    LOG_WRN("Invalid command. Format: <bulb> <r> <g> <b>, each 0-255");
                }
            }

            /* Empty lines (len == 0) are ignored, e.g. the \n after a \r */
            len = 0;
            overflow = false;
            continue;
        }

        /* Echo the character so the user can see what they type */
        printk("%c", byte);

        /* Leave room for the '\0' terminator */
        if (len < LINE_MAX - 1) {
            line[len++] = byte;
        } else {
            overflow = true; /* keep discarding until Enter */
        }
    }
}

/* 1KB stack, priority 5: runs ahead of bulb_mgr_thread (priority 7) */
K_THREAD_DEFINE(rx_id, 1024, rx_thread, NULL, NULL, NULL, 5, 0, 0);

int uart_rx_init(void)
{
    int err;

    if (!device_is_ready(uart)) {
        return -ENODEV;
    }

    err = uart_irq_callback_user_data_set(uart, uart_receive, NULL);
    if (err) {
        return err;
    }

    uart_irq_rx_enable(uart);
    return 0;
}
```
