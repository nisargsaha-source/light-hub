## tests/packet/testcase.yaml
```yaml
tests:
  light_hub.packet:
    platform_allow: qemu_riscv32
    integration_platforms:
      - qemu_riscv32
    tags: packet
```

## tests/protocol/testcase.yaml
```yaml
tests:
  light_hub.protocol:
    platform_allow: qemu_riscv32
    integration_platforms:
      - qemu_riscv32
    tags: protocol
```
